## drivers/elphel/Kconfig
```kconfig
#
# Elphel devices
#

menu "Elphel devices"
config LTC3589
	tristate "Support LTC3589 voltage regulator"
	depends on I2C && SYSFS
	help
	  Say Y here if you have a Elphel board 10393.
endmenu
```

## src/drivers/elphel/Kconfig
```kconfig
#                                                                                                                                    
# Elphel devices                                                                                                                     
#                                                                                                                                    
                                                                                                                                     
menu "Elphel devices"
config ELPHEL393
        tristate "Support Elphel 10393 board voltage regulator, DMA memory allocator"
# add more
#       depends on I2C && SYSFS
        help
          Say Y here if you have a Elphel board 10393.

config ELPHELDRVONMICROZED
        tristate "Provide only Elphel features which are compatible with Microzed"
        help
          Say Y here if you debug Elphel camera code on Microzed board.

config ELPHEL393_INIT
		bool
		default y
		help
			If unsure, say Y.
			
config ELPHEL393_EXTERNAL
        tristate "Compile some Elphel drivers as external modules"
        default m
        help
            If unsure, say Y.
			
endmenu  
```
